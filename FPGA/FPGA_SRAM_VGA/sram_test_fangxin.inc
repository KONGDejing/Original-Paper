-- WARNING: Do NOT edit the input and output ports in this file in a text
-- editor if you plan to continue editing the block that represents it in
-- the Block Editor! File corruption is VERY likely to occur.

-- Copyright (C) 1991-2011 Altera Corporation
-- Your use of Altera Corporation's design tools, logic functions 
-- and other software and tools, and its AMPP partner logic 
-- functions, and any output files from any of the foregoing 
-- (including device programming or simulation files), and any 
-- associated documentation or information are expressly subject 
-- to the terms and conditions of the Altera Program License 
-- Subscription Agreement, Altera MegaCore Function License 
-- Agreement, or other applicable license agreement, including, 
-- without limitation, that your use is for the sole purpose of 
-- programming logic devices manufactured by Altera and sold by 
-- Altera or its authorized distributors.  Please refer to the 
-- applicable agreement for further details.


-- Generated by Quartus II Version 11.0 (Build Build 208 07/03/2011)
-- Created on Mon Apr 14 21:24:07 2014

FUNCTION sram_test_fangxin (CLK, RSTn)
	WITH (_X, _Y, _XOFF, _YOFF, IDLE, WRT0, WRT1, REA0, REA1)
	RETURNS (sram_addr[17..0], sram_wr_n, sram_ce_n, sram_data[7..0], HSYNC, VSYNC, RGB_Sig[2..0], led);
